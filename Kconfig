## Kconfig
```kconfig
menu "nkolban's c++ wrappers"

menuconfig NKOLBAN
    bool "nkolban's c++ wrappers"
    default n
    help
        Select this option to use nkolban's c++ wrappers.

menuconfig NKOLBAN_BLE
    bool "bluetooth wrappers"
    depends on BT_ENABLED && NKOLBAN
    default n
    help
        Select this option to use nkolban's c++ bluetooth ble wrappers.

menuconfig NKOLBAN_BLE2902
    bool "BLE2902"
    depends on NKOLBAN_BLE
    default n
    help
        Select this option to use nkolban's c++ bluetooth BLE2902 wrappers.

endmenu
```
